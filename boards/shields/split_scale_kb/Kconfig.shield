## boards/shields/split_scale_kb/Kconfig.shield
```kconfig
config SHIELD_SPLIT_SCALE_KB_LEFT
    def_bool $(shields_list_contains,split_scale_kb_left)
  
config SHIELD_SPLIT_SCALE_KB_RIGHT
    def_bool $(shields_list_contains,split_scale_kb_right)
  
```
