#include "split_scale_kb.dtsi"

/ {
    kscan0: kscan0 {
        compatible = "zmk,kscan-gpio-matrix";
        diode-direction = "col2row";
        wakeup-source;

        col-gpios
            = <&xiao_d 1 (GPIO_ACTIVE_HIGH | GPIO_PULL_UP)> // ここをPULL_UPに変更
            , <&xiao_d 2 (GPIO_ACTIVE_HIGH | GPIO_PULL_UP)> // ここをPULL_UPに変更
            , <&xiao_d 3 (GPIO_ACTIVE_HIGH | GPIO_PULL_UP)> // ここをPULL_UPに変更
            , <&xiao_d 4 (GPIO_ACTIVE_HIGH | GPIO_PULL_UP)> // ここをPULL_UPに変更
            , <&xiao_d 5 (GPIO_ACTIVE_HIGH | GPIO_PULL_UP)> // ここをPULL_UPに変更
            ;

        row-gpios
            = <&xiao_d 10 GPIO_ACTIVE_HIGH>
            , <&xiao_d 9 GPIO_ACTIVE_HIGH>
            , <&xiao_d 8 GPIO_ACTIVE_HIGH>
            , <&xiao_d 7 GPIO_ACTIVE_HIGH>
            ;
    };
};

&physical_layout_split_scale_kb {
    kscan = <&kscan0>;
};

